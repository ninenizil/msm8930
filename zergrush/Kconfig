## zergrush/Kconfig
```kconfig
menuconfig ZERGRUSH
	bool "Custom ZERGRUSH Configurations" if EXPERT
	default y
	help
	  Modifications for the ZERGRUSH kernel

if ZERGRUSH
menu "Speedhacks Options"
menu "Overclock CPU"
config CPU_OVERCLOCK_15_GHZ
	boolean "Overclocking to 1.5GHz"
	default y
	help
	  Overclock for MSM8930 chipset. (Based on MSM8960 acpuclock table)

config CPU_OVERCLOCK_17_GHZ
	boolean "Overclocking to 1.7GHz"
	depends on CPU_OVERCLOCK_15_GHZ
	default y
	help
	  Overclock for MSM8930 chipset. (Based on MSM8960 acpuclock table)

config CPU_OVERCLOCK_18_GHZ
	boolean "Overclocking to 1.8GHz"
	depends on CPU_OVERCLOCK_17_GHZ
	default n
	help
	  Overclock for MSM8930 chipset. (Based on MSM8960 acpuclock table)

endmenu
endmenu

menu "Block Schedulers"
endmenu

menu "Extra CPU Govs"
config CPU_ONDEMANDX
	boolean "Enable OnDemandX Governor"
	depends on CPU_FREQ
	default y
	help
	  None

config CPU_INTELLIDEMAND
	boolean "Enable Intellidemand Governor"
	depends on CPU_FREQ
	default y
	help
	  None

config CPU_INTERACTIVEX
	boolean "Enable InteractiveX Governor"
	depends on CPU_FREQ
	default y
	help
	  None

config CPU_SMARTASS2
	boolean "Enable SmartassV2 Governor"
	depends on CPU_FREQ
	default y
	help
	  None

config CPU_BADASS
	boolean "Enable Badass Governor"
	depends on CPU_FREQ
	default y
	help
	  None

if CPU_BADASS
menu "Badass CPU GOV options"
        config CPU_FREQ_GOV_BADASS_2_PHASE
                tristate "'2-phase' power-efficiency badass algorithm"
                depends on CPU_BADASS
                help
                  '2-phase' - This driver adds a new algo to save power

        config CPU_FREQ_GOV_BADASS_2_PHASE_FREQ
                int "'2-phase' badass frequency"
                default 918000
	                depends on CPU_BADASS
                depends on CPU_FREQ_GOV_BADASS_2_PHASE

        config CPU_FREQ_GOV_BADASS_3_PHASE
                tristate "'3-phase' power-efficiency badass algorithm"
                depends on CPU_BADASS
                depends on CPU_FREQ_GOV_BADASS_2_PHASE
                help
                  '3-phase' - This driver adds a new algo to save power

        config CPU_FREQ_GOV_BADASS_3_PHASE_FREQ
                int "'3-phase' badass frequency"
                default 1188000
                depends on CPU_BADASS
                depends on CPU_FREQ_GOV_BADASS_2_PHASE
                depends on CPU_FREQ_GOV_BADASS_3_PHASE

        config CPU_FREQ_GOV_BADASS_GPU_CONTROL
                tristate "'gpu_control' power-efficiency badass algorithm"
                depends on CPU_BADASS
                depends on CPU_FREQ_GOV_BADASS_2_PHASE
                help
                  'gpu_control' - This driver adds a new algo to save power

        config CPU_FREQ_GOV_BADASS_LOWBAT_POWERSAVE
                tristate "'lowbat_powersave' power-efficiency badass algorithm"
                depends on CPU_BADASS
                help
                  'lowbat_powersave' - This driver adds a new algo to save power

        config CPU_FREQ_GOV_BADASS_ALLOW_BYPASS
                tristate "Allows bypassing phases"
                depends on CPU_BADASS
                depends on CPU_FREQ_GOV_BADASS_2_PHASE
                help
                  'allow_bypass' - This driver adds a bypass to the phases
        endmenu
endif # BADASS GOV OPTIONS

config CPU_ASSWAX
	boolean "Enable Asswax Governor"
	depends on CPU_FREQ
	default y
	help
	  None

config CPU_SMOOTHASS
	boolean "Enable Smoothass Governor"
	depends on CPU_FREQ
	default y
	help
	  None

config CPU_BRAZILIANWAX
	boolean "Enable Brazilianwax Governor"
	depends on CPU_FREQ
	default y
	help
	  None

config CPU_SAVAGEDZEN
	boolean "Enable SavagedZen Governor"
	depends on CPU_FREQ
	default y
	help
	  None

config CPU_LAGFREE
	boolean "Enable Lagfree Governor"
	depends on CPU_FREQ
	default y
	help
	  None

config CPU_LULZACTIVE
	boolean "Enable LulzActive Governor"
	depends on CPU_FREQ
	default y
	help
	  None

config CPU_WHEATLEY
	boolean "Enable Wheatley Governor"
	depends on CPU_FREQ
	default y
	help
	  None
endmenu

endif # ZERGRUSH
```
